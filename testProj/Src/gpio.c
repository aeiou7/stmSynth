#include "gpio.h"
#include "stm32f4xx_hal_gpio.h"
#include <stdint.h>


// fuction for rnning gpio inits, typically generated by cubemx.
void gpioInit() {
    __HAL_RCC_GPIOC_CLK_ENABLE();
    __HAL_RCC_GPIOH_CLK_ENABLE();
    __HAL_RCC_GPIOA_CLK_ENABLE();
    __HAL_RCC_GPIOB_CLK_ENABLE();
    gpioSpi1Init();
    gpioSpi2Init();
    gpioSpi3Init();
}
void gpioSpi1Init(){
    GPIO_InitTypeDef GPIO_InitStruct = {0};
    /* USER CODE BEGIN SPI1_MspInit 0 */

    /* USER CODE END SPI1_MspInit 0 */
      /* Peripheral clock enable */
      __HAL_RCC_SPI1_CLK_ENABLE();

      __HAL_RCC_GPIOA_CLK_ENABLE();
      /**SPI1 GPIO Configuration
      PA5     ------> SPI1_SCK
      PA7     ------> SPI1_MOSI
      */
      GPIO_InitStruct.Pin = GPIO_PIN_5|GPIO_PIN_7;
      GPIO_InitStruct.Mode = GPIO_MODE_AF_PP;
      GPIO_InitStruct.Pull = GPIO_NOPULL;
      GPIO_InitStruct.Speed = GPIO_SPEED_FREQ_VERY_HIGH;
      GPIO_InitStruct.Alternate = GPIO_AF5_SPI1;
      HAL_GPIO_Init(GPIOA, &GPIO_InitStruct);

    /* USER CODE BEGIN SPI1_MspInit 1 */

    /*Configure GPIO pins : SPI1_RS_Pin SPI1_CS_Pin SPI2_CLR_Pin SPI2_SYNC_Pin
                             SPI2_LDAC_Pin SPI3_SYNC_Pin SPI3_LDAC_Pin SPI3_CLR_Pin */
    GPIO_InitStruct.Pin = SPI1_RS_Pin|SPI1_CS_Pin;
    GPIO_InitStruct.Mode = GPIO_MODE_OUTPUT_PP;
    GPIO_InitStruct.Pull = GPIO_NOPULL;
    GPIO_InitStruct.Speed = GPIO_SPEED_FREQ_LOW;
    HAL_GPIO_Init(GPIOA, &GPIO_InitStruct);

    /*Configure GPIO pin : SPI1_DC_Pin */
    GPIO_InitStruct.Pin = SPI1_DC_Pin;
    GPIO_InitStruct.Mode = GPIO_MODE_OUTPUT_PP;
    GPIO_InitStruct.Pull = GPIO_NOPULL;
    GPIO_InitStruct.Speed = GPIO_SPEED_FREQ_LOW;
    HAL_GPIO_Init(SPI1_DC_GPIO_Port, &GPIO_InitStruct);
    /* USER CODE END SPI1_MspInit 1 */
}
void gpioSpi1DCSet(uint8_t state){
    HAL_GPIO_WritePin(SPI1_DC_GPIO_Port, SPI1_DC_Pin, state);
}
void gpioSpi1RSSet(uint8_t state){
    HAL_GPIO_WritePin(SPI1_RS_GPIO_Port, SPI1_RS_Pin, state);
}
void gpioSpi1CSSet(uint8_t state){
    HAL_GPIO_WritePin(SPI1_RS_GPIO_Port, SPI1_RS_Pin, state);
}
void gpioSpi2Init(){

    GPIO_InitTypeDef GPIO_InitStruct = {0};
    /* USER CODE BEGIN SPI2_MspInit 0 */

    /* USER CODE END SPI2_MspInit 0 */
      /* Peripheral clock enable */
      __HAL_RCC_SPI2_CLK_ENABLE();

      __HAL_RCC_GPIOB_CLK_ENABLE();
      /**SPI2 GPIO Configuration
      PB10     ------> SPI2_SCK
      PB15     ------> SPI2_MOSI
      */
      GPIO_InitStruct.Pin = GPIO_PIN_10|GPIO_PIN_15;
      GPIO_InitStruct.Mode = GPIO_MODE_AF_PP;
      GPIO_InitStruct.Pull = GPIO_NOPULL;
      GPIO_InitStruct.Speed = GPIO_SPEED_FREQ_VERY_HIGH;
      GPIO_InitStruct.Alternate = GPIO_AF5_SPI2;
      HAL_GPIO_Init(GPIOB, &GPIO_InitStruct);

    /* USER CODE BEGIN SPI2_MspInit 1 */

    /*Configure GPIO pins : SPI1_RS_Pin SPI1_CS_Pin SPI2_CLR_Pin SPI2_SYNC_Pin
                             SPI2_LDAC_Pin SPI3_SYNC_Pin SPI3_LDAC_Pin SPI3_CLR_Pin */
    GPIO_InitStruct.Pin = SPI2_CLR_Pin|SPI2_SYNC_Pin|SPI2_LDAC_Pin;
    GPIO_InitStruct.Mode = GPIO_MODE_OUTPUT_PP;
    GPIO_InitStruct.Pull = GPIO_NOPULL;
    GPIO_InitStruct.Speed = GPIO_SPEED_FREQ_LOW;
    HAL_GPIO_Init(GPIOA, &GPIO_InitStruct);


}
void gpioSpi3Init(){

    GPIO_InitTypeDef GPIO_InitStruct = {0};
    /* USER CODE BEGIN SPI3_MspInit 0 */

      /* USER CODE END SPI3_MspInit 0 */
        /* Peripheral clock enable */
        __HAL_RCC_SPI3_CLK_ENABLE();

        __HAL_RCC_GPIOB_CLK_ENABLE();
        __HAL_RCC_GPIOC_CLK_ENABLE();
        /**SPI3 GPIO Configuration
        PB12     ------> SPI3_SCK
        PC12     ------> SPI3_MOSI
        */
        GPIO_InitStruct.Pin = GPIO_PIN_12;
        GPIO_InitStruct.Mode = GPIO_MODE_AF_PP;
        GPIO_InitStruct.Pull = GPIO_NOPULL;
        GPIO_InitStruct.Speed = GPIO_SPEED_FREQ_VERY_HIGH;
        GPIO_InitStruct.Alternate = GPIO_AF7_SPI3;
        HAL_GPIO_Init(GPIOB, &GPIO_InitStruct);

        GPIO_InitStruct.Pin = GPIO_PIN_12;
        GPIO_InitStruct.Mode = GPIO_MODE_AF_PP;
        GPIO_InitStruct.Pull = GPIO_NOPULL;
        GPIO_InitStruct.Speed = GPIO_SPEED_FREQ_VERY_HIGH;
        GPIO_InitStruct.Alternate = GPIO_AF6_SPI3;
        HAL_GPIO_Init(GPIOC, &GPIO_InitStruct);

      /* USER CODE BEGIN SPI3_MspInit 1 */

      /*Configure GPIO pins : SPI1_RS_Pin SPI1_CS_Pin SPI2_CLR_Pin SPI2_SYNC_Pin
                               SPI2_LDAC_Pin SPI3_SYNC_Pin SPI3_LDAC_Pin SPI3_CLR_Pin */
      GPIO_InitStruct.Pin = SPI3_SYNC_Pin|SPI3_LDAC_Pin|SPI3_CLR_Pin;
      GPIO_InitStruct.Mode = GPIO_MODE_OUTPUT_PP;
      GPIO_InitStruct.Pull = GPIO_NOPULL;
      GPIO_InitStruct.Speed = GPIO_SPEED_FREQ_LOW;
      HAL_GPIO_Init(GPIOA, &GPIO_InitStruct);


}

//set gpio pin mode to read of write
void gpioSetPinMode(uint16_t pin, GPIO_TypeDef *port, uint8_t mode){
  GPIO_InitTypeDef GPIO_InitStruct = {0};
    if(mode){
        GPIO_InitStruct.Mode = GPIO_MODE_OUTPUT_PP;
        GPIO_InitStruct.Pin = pin;

        GPIO_InitStruct.Pull = GPIO_NOPULL;
        HAL_GPIO_Init(port, &GPIO_InitStruct);
    }else{
        GPIO_InitStruct.Mode = GPIO_MODE_INPUT;
        GPIO_InitStruct.Pin = pin;

        GPIO_InitStruct.Pull = GPIO_NOPULL;
        HAL_GPIO_Init(port, &GPIO_InitStruct);
    }
}
